## CMakeLists.txt
```
# Find Zephyr. This also loads Zephyr's build system.
cmake_minimum_required(VERSION 3.13.1)
find_package(Zephyr)
project(epos_controller_model)

# Add your source file to the "app" target. This must come after
# find_package(Zephyr) which defines the target.
target_sources(app PRIVATE src/main.c
    src/codegeneration/assdf_grt_rtw/assdf.c
    src/codegeneration/assdf_grt_rtw/assdf_data.c 
)

target_include_directories(app PUBLIC src/codegeneration/assdf_grt_rtw main.c)
target_include_directories(app PUBLIC src/R2021a/extern/include main.c)
target_include_directories(app PUBLIC src/R2021a/simulink/include main.c)
```

## prj.conf
```kconfig
CONFIG_CAN=y
CONFIG_CAN_INIT_PRIORITY=80
CONFIG_CAN_MAX_FILTER=1

CONFIG_LOG=y
CONFIG_CAN_LOG_LEVEL_DBG=y
CONFIG_DEBUG_OPTIMIZATIONS=y

CONFIG_CBPRINTF_FP_SUPPORT=y
```

## stm32f4_disco.overlay
```dts
&can1 {
	status = "okay";
	pinctrl-0 = <&can1_rx_pd0 &can1_tx_pd1>;
	bus-speed = <125000>;

	// compatible = "st,stm32-can";
	// #address-cells = <1>;
	// #size-cells = <0>;
	// reg = <0x40006400 0x400>;
	// interrupts = <19 0>, <20 0>, <21 0>, <22 0>;
	// interrupt-names = "TX", "RX0", "RX1", "SCE";
	// clocks = <&rcc 2 0x02000000>;
	// status = "disabled";
	// label = "CAN_1";
	// bus-speed = <125000>;
	// sjw = <1>;
	prop-seg = <2>;
	phase-seg1 = <7>;
	phase-seg2 = <6>;
};

// compatible = "microchip,mcp2515";
// 		spi-max-frequency = <1000000>;
// 		int-gpios = <&arduino_header 8 GPIO_ACTIVE_LOW>; /* D2 */
// 		status = "okay";
// 		label = "CAN_1";
// 		reg = <0x0>;
// 		osc-freq = <16000000>;
// 		bus-speed = <125000>;
// 		sjw = <1>;
// 		prop-seg = <2>;
// 		phase-seg1 = <7>;
// 		phase-seg2 = <6>;
// 		#address-cells = <1>;
// 		#size-cells = <0>;

&can2 {
	status = "disabled";
};

/ {

	chosen {
		zephyr,can-primary = &can1;
	};

};
```

## src/main.c
```c
#include <zephyr.h>
#include <device.h>
#include <devicetree.h>
#include <drivers/gpio.h>

#include "assdf.h"


void main()
{
    assdf_initialize();

    for(float i = 0; i < 10; i+=0.01)
    {
        if( i >= 1.0 && i < 2.0 )
        {
            assdf_U.In1 = 1.0;
        }else{
            assdf_U.In1 = 0.0;
        }

        assdf_step();

        printf("X: %.2f Y: %.2f\n", assdf_U.In1, assdf_Y.Out1);
    }

	return 0;
}
```

## src/test.cpp
```c
/*
 * Copyright (c) 2016 Intel Corporation
 *
 * SPDX-License-Identifier: Apache-2.0
 */

#include <zephyr.h>
#include <device.h>
#include <devicetree.h>
#include <drivers/gpio.h>

#include "assdf.h"


void main(void)
{
	ExtU_assdf_T inp{0.0};

    assdfModelClass* subsys = new assdfModelClass();

    subsys->initialize();

    subsys->setExternalInputs(&inp);

    for(float i = 0; i < 10; i+=0.01)
    {
        if( i >= 1.0 && i < 2.0 )
        {
            inp.In1 = 1.0;
        }else{
            inp.In1 = 0.0;
        }

        subsys->setExternalInputs(&inp);
        subsys->step();

        // std::cout << inp.In1 << " " << (subsys->getExternalOutputs()).Out1 << "\n";
    }

    subsys->~assdfModelClass();

	return 0;
}
```
